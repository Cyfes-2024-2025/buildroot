## package/ptrauth/Config.in
```kconfig
config BR2_PACKAGE_PTRAUTH
	bool "ptrauth"
	help
	  Pointer auth module implementation.
```

## package/test-package/Config.in
```kconfig
config BR2_PACKAGE_TEST_PACKAGE
	bool "test-package"
	help
	  This is a test package.
```
